/**
 * @file ZYM.cpp
 * @author sea (zhangseammm@163.com)
 * @brief This is for a smart clock, but many functions needed 
 * @version 0.1
 * @date 2021-12-09
 * 
 * @copyright Copyright (c) 2021
 * 
 */

#include <stdio.h>
#include <ArduinoJson.h>
#include <Adafruit_GFX.h>
#include <FastLED.h>
#include <FastLED_NeoMatrix.h>
#include <Fonts/TomThumb.h>
#include <Wire.h>
#include "displayHelper.h"
#include <HTTPClient.h>
#include <WiFi.h>   // For WiFi
#include "time.h"   // For time things
#include "RTClib.h" // For DS3231 RTC Module, also DS1307, PCF8523, & PCF8563. https://github.com/adafruit/RTClib
#include <Wire.h>   // For I2C Communication (DS3231)
#include <Arduino.h>
#include <Wire.h>
#include "EEPROM.h"
/*Const value initialize*/

#define I2C_SDA 21 //timer address
#define I2C_SCL 22
#define button_pin 14
const uint16_t sleep1[]={0x0,0x0,0x4962,0x0,0x0,0x0,0x0,0x0,0x0,0x4962,0x0,0x0,0x0,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0x0,0x0};
//const uint16_t ZHDOG[] = {0x7f6, 0x7f6, 0x7f6, 0x7f6, 0x0, 0x7f6, 0x0, 0x0, 0x7f6, 0x0, 0x0, 0x0, 0x7f6,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 0x7f6, 0x7f6};
const uint16_t back1[]={0xffff,0xffff,0xffff,0xffff,0xf81f,0xf81f,0xf81f,0xf81f,0x1f,0x1f,0x1f,0x1f,0x7fc,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0xf9e0,0xf9e0};
const uint16_t cangshu[]={0x0,0x0,0x8a08,0x8a08,0x0,0x0,0x8a08,0x8a08,0x8a08,0x8a08,0x8a08,0x8a08,0x8a08,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0x0,0x0};
const uint16_t dog[]={0x62c9,0x62c9,0x62c9,0x62a8,0x62c9,0x841,0x841,0x841,0x62a8,0x62c9,0x62c9,0x62c9,0x62c9,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0x841,0x841};
const uint16_t sleep2[]={0x0,0x0,0x0,0xefe0,0xefe0,0x0,0x0,0x0,0x0,0x0,0x0,0x0,0x0,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0x0,0x0};
const uint16_t sleep3[]={0x0,0x0,0x0,0xefe0,0xefe0,0x0,0x0,0x0,0x0,0x0,0x0,0x0,0x0,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0x0,0x0};
#define MODE_NUM 7
#define led_num 192
#define MATRIX_WIDTH 24
#define MATRIX_HEIGHT 8

//#define MATRIX_LED_PIN 18
#define MATRIX_LED_PIN 5

#define MATRIX_MAX_BRIGHTNESS 20
#define SOUND_PIN 16 //音箱
#define BATTERY_PIN 34
#define EEPROM_SIZE 128
const char *ssid =         "CMCC-QKdN";
const char *password =     "qwertyuiop@9";
const char *ssid_home =     "FYX_30C9_5g";
const char *password_home = "15361672738";//tianm
const int UTCOffset = +8;
String tagethttp_guilin = "https://api.seniverse.com/v3/weather/now.json?key=SBchbHzye5mh3vfdn&location=guilin&language=en";
String tagethttp_tianmen = "https://api.seniverse.com/v3/weather/now.json?key=SBchbHzye5mh3vfdn&location=tianmen&language=en";
//String tagethttp_luzhou = "https://api.seniverse.com/v3/weather/now.json?key=SkOoK2fMdZ0z-S6dC&location=luzhou&language=en";
int system_flag = 0; //0: normal //1: coonect wifi fail//2:coonect zhixin fail //3:RTC fail //:
// 矩阵设置
CRGB leds[led_num];
struct tm timeinfo;
RTC_DS3231 rtc;
// gobel vaule
int temperature = 0; // 天气温度
int hour;
int minute;
int month;
int day;
int sleep_time = 0;
int button_state = 0;
static uint32_t last_time = 0;
int weather;
int weathercode;
const int addr1 = 1;
const int addr2 = 2;
int sleep_hour = 0;
int sleep_minute = 0;
int way1[3][2] = {{-1, 2}, {-1, 3}, {0, 4}};
int way2[3][2] = {{0, 4}, {1, 3}, {2, 2}};
int way3[3][2] = {{2, 2}, {2, 3}, {3, 4}};
int way4[4][2] = {{3, 4}, {2, 3}, {1, 3}, {0, 2}};
//Initialize LED
FastLED_NeoMatrix *matrix;
void initMatrix()
{
  matrix = new FastLED_NeoMatrix(leds, MATRIX_WIDTH, MATRIX_HEIGHT, NEO_MATRIX_TOP + NEO_MATRIX_LEFT + NEO_MATRIX_ROWS + NEO_MATRIX_ZIGZAG);
  FastLED.addLeds<NEOPIXEL, MATRIX_LED_PIN>(leds, led_num).setCorrection(TypicalLEDStrip);
  matrix->begin();
  matrix->setTextWrap(false);
  matrix->setBrightness(EEPROM.read(addr2));
  matrix->setFont(&TomThumb);
}

//change modes and eliminate fltter
void SwMode()
{
  uint32_t now_time;
  now_time = millis();
  if (now_time - last_time > 300)
  {
    button_state = (button_state + 1) % MODE_NUM;
    last_time = millis();
  }
}
//Obtian RTC time
void getRTCTime()
{
  DateTime now = rtc.now();
  hour = now.hour();
  minute = now.minute();
  month = now.month();
  day = now.day();
  //Serial.printf("%02d/%02d/%04d (%02d:%02d:%02d)\n", now.month(), now.day(), now.year(), now.hour(), now.minute(), now.second());
}
//animatation
void showConnectFail()
{
  matrix->setCursor(1, 7);
  matrix->clear();
  matrix->print("WIFAIL");
  matrix->show();
}
void showConnectSuccess(FastLED_NeoMatrix *matrix)
{
  showWiFiDoneAnimation(matrix, 1);
}
void showOpenWifi()
{
  matrix->setCursor(2, 6);
  matrix->setTextColor(matrix->Color(255, 255, 255));
  matrix->print("WiFi");
  matrix->setCursor(18, 6);
  matrix->setTextColor(matrix->Color(138, 43, 255));
  matrix->print("V");

}
void showCloseWifi()
{
  matrix->setCursor(2, 6);
  matrix->setTextColor(matrix->Color(255, 255, 255));
  matrix->print("WiFi");

  matrix->setCursor(18, 6);
  matrix->setTextColor(matrix->Color(255, 0, 0));
  matrix->print("X");

}
void yellowFace(FastLED_NeoMatrix *matrix, int x)
{
  matrix->fillRect(0,0,6+x,8,matrix->Color(0, 0, 0));
  matrix->drawFastHLine(x, 0, 5, matrix->Color(255, 215, 0));     //金色
  matrix->drawFastHLine(x - 1, 1, 2, matrix->Color(255, 215, 0)); //金色
  matrix->drawFastHLine(x + 2, 1, 4, matrix->Color(255, 215, 0)); //金色
  matrix->drawFastHLine(x - 2, 2, 9, matrix->Color(255, 215, 0)); //金色
  matrix->drawFastHLine(x - 2, 3, 9, matrix->Color(255, 215, 0)); //金色
  matrix->drawFastHLine(x - 2, 4, 9, matrix->Color(255, 215, 0)); //金色
  matrix->drawFastHLine(x - 2, 5, 9, matrix->Color(255, 215, 0)); //金色
  matrix->drawFastHLine(x - 1, 6, 7, matrix->Color(255, 215, 0)); //金色
  matrix->drawFastHLine(x, 7, 5, matrix->Color(255, 215, 0));     //金色
  matrix->show();
}
void yellowFaceOpen(FastLED_NeoMatrix *matrix, int x)
{
  matrix->fillRect(0,0,6+x,8,matrix->Color(0, 0, 0));
  matrix->drawFastHLine(x, 0, 6, matrix->Color(255, 215, 0));     //金色
  matrix->drawFastHLine(x - 1, 1, 2, matrix->Color(255, 215, 0)); //金色
  matrix->drawFastHLine(x + 2, 1, 3, matrix->Color(255, 215, 0)); //金色
  matrix->drawFastHLine(x - 2, 2, 6, matrix->Color(255, 215, 0)); //金色
  matrix->drawFastHLine(x - 2, 3, 5, matrix->Color(255, 215, 0)); //金色
  matrix->drawFastHLine(x - 2, 4, 5, matrix->Color(255, 215, 0)); //金色
  matrix->drawFastHLine(x - 2, 5, 6, matrix->Color(255, 215, 0)); //金色
  matrix->drawFastHLine(x - 1, 6, 6, matrix->Color(255, 215, 0)); //金色
  matrix->drawFastHLine(x, 7, 6, matrix->Color(255, 215, 0));     //金色
  matrix->show();
}
/**
 * @brief To show the eyes,x and y are the relative coordinate of white circle.
 * 
 * @param matrix LED 
 * @param x white circle x coord
 * @param eye_b 
 * @param eye_y 
 */
void showEyes(FastLED_NeoMatrix *matrix, int x, int eye_b, int eye_y)
{
  matrix->drawFastHLine(x, 0, 4, matrix->Color(255, 255, 255));     //金色
  matrix->drawFastHLine(x - 1, 1, 6, matrix->Color(255, 255, 255)); //金色
  matrix->drawFastHLine(x - 2, 2, 8, matrix->Color(255, 255, 255)); //金色
  matrix->drawFastHLine(x - 2, 3, 8, matrix->Color(255, 255, 255)); //金色
  matrix->drawFastHLine(x - 2, 4, 8, matrix->Color(255, 255, 255)); //金色
  matrix->drawFastHLine(x - 2, 5, 8, matrix->Color(255, 255, 255)); //金色
  matrix->drawFastHLine(x - 1, 6, 6, matrix->Color(255, 255, 255)); //金色
  matrix->drawFastHLine(x, 7, 4, matrix->Color(255, 255, 255));     //金色
  matrix->fillRect(x + eye_b, eye_y, 2, 2, matrix->Color(0, 0, 0));
}

void showYellowFace(FastLED_NeoMatrix *matrix)
{
  for (int i = -9; i < 27; i++)
  {
    if (i % 2)
    {
      yellowFace(matrix, i);
    }
    else
    {
      yellowFaceOpen(matrix, i);
    }
    delay(150);
    if (button_state != 0)
      break;
  }
}
void getWeather(String str)
{
  DynamicJsonDocument doc(2048);
  HTTPClient https;
  https.begin(str);
  int httpCode = https.GET();
  if (httpCode == 200)
  {
    String payload = https.getString();
    deserializeJson(doc, payload);
    JsonObject results_0 = doc["results"][0];
    JsonObject results_0_now = results_0["now"];
    weather = results_0_now["text"];
    weathercode = results_0_now["code"];
    temperature = results_0_now["temperature"];
  }
  else
  {
    showConnectFail();
    system_flag = 2;
  }
}
int home_flag=0;
//Connect to wifi within 10s and update weather RTC time ,otherwise activate local RTC time
void initWIFI()
{
  WiFi.begin(ssid, password);
  int wait_count = 0;
  while ((WiFi.status() != WL_CONNECTED)&(wait_count!=11))
  {
    delay(500);
    wait_count++;
    if (wait_count == 10)
    {
      WiFi.disconnect();
      WiFi.begin(ssid_home, password_home);
      wait_count=0;
      while ((WiFi.status() != WL_CONNECTED)&(wait_count!=11))
      {
        home_flag=1;
        wait_count++;
        clearMatrix(matrix);
        matrix->drawRGBBitmap(0, 0, dog, 24, 8);
        matrix->show();
        delay(500);
        if(wait_count == 10)
        {
          wait_count=11;
          system_flag=1;
          clearMatrix(matrix);
          matrix->setCursor(1, 6);
    matrix->setTextColor(matrix->Color(255, 0, 0));
    matrix->print("Fail!!!");
    matrix->show();
    
        }
      }
    } 
  }

  if (system_flag != 1)
  {
    if (home_flag) 
    {getWeather(tagethttp_tianmen);}
    
    else {getWeather(tagethttp_guilin);}
    configTime(0, 0, "pool.ntp.org");
    bool temp = getLocalTime(&timeinfo, 3000);
    if (temp)
    {
      Serial.println("change time");
      rtc.adjust(DateTime(mktime(&timeinfo) + UTCOffset * 3600));
    }

    WiFi.disconnect(); //关闭WIFI
    showConnectSuccess(matrix);
  }
}

void setup()
{
  EEPROM.begin(EEPROM_SIZE);
  Serial.begin(115200);
  initMatrix();
  matrix->fillScreen(matrix->Color(255,187,255));
  
    matrix->setCursor(1, 6);
    matrix->setTextColor(matrix->Color(0, 0, 0));
    matrix->print("YUMMY");
    matrix->show();
  /*External button interrupt setting*/
  pinMode(button_pin, INPUT_PULLUP);
  attachInterrupt(button_pin, SwMode, FALLING);
  /***********/
  //music
  pinMode(SOUND_PIN, OUTPUT);
  digitalWrite(SOUND_PIN, 0);
  //Battery V detect
  //pinMode(BATTERY_PIN, INPUT); //电压adc
  //RTC initialize and get weather
  if (!rtc.begin())
  {
    system_flag = 3;
  }
  if (EEPROM.read(addr1) == 1)
  {
    initWIFI();
  }
  showYellowFace(matrix);
  button_state = 0;
}

void loop() //0:eye,   1:clock,  2:weather,  3:light
{
  switch (button_state)
  {
  case 0:
    for (int j = 0; j < 3; j++)
    {
      if (button_state != 0)
        break;
      clearMatrix(matrix);
      showEyes(matrix, 5, way1[j][0], way1[j][1]);
      showEyes(matrix, 15, way1[j][0], way1[j][1]);
      matrix->show();
      delay(200);
    }
    if (button_state != 0)
      break;
   delay(3000);
    for (int j = 0; j < 3; j++)
    {
      if (button_state != 0)
        break;
      clearMatrix(matrix);
      showEyes(matrix, 5, way2[j][0], way2[j][1]);
      showEyes(matrix, 15, way2[j][0], way2[j][1]);
      matrix->show();
      delay(200);
    }
    if (button_state != 0)
      break;
    delay(3000);
    for (int j = 0; j < 3; j++)
    {
      if (button_state != 0)
        break;
      clearMatrix(matrix);
      showEyes(matrix, 5, way3[j][0], way3[j][1]);
      showEyes(matrix, 15, way3[j][0], way3[j][1]);
      matrix->show();
      delay(200);
    }
    if (button_state != 0)
      break;
    delay(3000);
    for (int j = 0; j < 4; j++)
    {
      if (button_state != 0)
        break;
      clearMatrix(matrix);
      showEyes(matrix, 5, way4[j][0], way4[j][1]);
      showEyes(matrix, 15, way4[j][0], way4[j][1]);
      matrix->show();
      delay(200);
    }
    if (button_state != 0)
      break;
    delay(3000);
    break;

  case 1:
    getRTCTime();
    clearMatrix(matrix);
    showTime(matrix, hour, minute, 2, 7, matrix->Color(0,191,255), 0);
    if (button_state != 1)
      break;
    delay(900);
    clearMatrix(matrix);
    showTime2(matrix, hour, minute, 2, 7, matrix->Color(0,191,255), 0);
    if (button_state != 1)
      break;
    delay(900);
    //Serial.printf("min is:%d,hour is:%d",sleep_minute,sleep_hour);
    if ((hour == sleep_hour) & (minute == sleep_minute))
    {
      clearMatrix(matrix);
      matrix->show();
      esp_deep_sleep_start();
      
    }
    else if ((hour == 17) & (minute == 20))
    {
      clearMatrix(matrix);
      matrix->drawRGBBitmap(0, 0, cangshu, 24, 8);
      matrix->show();
      delay(60000);
    }
    else if((hour == 23) & (minute == 00))
    {
      while((hour == 23) & (minute == 00))
      {
        clearMatrix(matrix);
        matrix->drawRGBBitmap(0, 0, sleep2, 24, 8);
        matrix->show();
         if (button_state != 1)
      break;
        delay(300);
        clearMatrix(matrix);
        matrix->drawRGBBitmap(0, 0, sleep3, 24, 8);
        matrix->show();
         if (button_state != 1)
      break;
        delay(300);
      }
    }
    break;

  case 2:
    clearMatrix(matrix);
    showDate(matrix, month, day, 3, 7, 0xffff, 0);
    break;

  case 3:
    clearMatrix(matrix);
    showTemperature(matrix, temperature, 12, 7, 0xffff, 0);
    showwether(matrix, weathercode, temperature); //天气图标
    Serial.printf("weater is: %d,temp is: %d ", weathercode, temperature);
    matrix->show();
    break;

  case 4:
    clearMatrix(matrix);
    matrix->setCursor(2, 6);
    matrix->setTextColor(matrix->Color(255, 255, 255));
    matrix->print("WiFi");
    matrix->show();
    delay(1000);
    if (button_state != 4)
      break;
    delay(1000);
    if (button_state != 4)
      break;
    delay(1000);
    if (button_state != 4)
      break;
    if (EEPROM.read(addr1) == 1) //1 open wifi 0 close wifi
    {

      EEPROM.write(addr1, 0);
      EEPROM.commit();
      clearMatrix(matrix);
      showCloseWifi();
      matrix->show();
      button_state = 0;
    }
    else
    {
      EEPROM.write(addr1, 1);
      EEPROM.commit();
      clearMatrix(matrix);
      showOpenWifi();
      matrix->show();
      button_state = 0;
    }
    showYellowFace(matrix);
    break;

  case 5:
    clearMatrix(matrix);
    matrix->drawRGBBitmap(0, 0, back1, 24, 8);
    matrix->show();
    delay(1500);
    if (button_state != 5)
        break;
    for (int n = 0; n < 100; n++)
    {
      if (button_state != 5)
        break;
      matrix->setBrightness((5 + n * 10) % 90);
      EEPROM.write(addr2, (5 + n * 10) % 90);
      EEPROM.commit();
      matrix->drawRGBBitmap(0, 0, dog, 24, 8);
      matrix->show();
      delay(1000);
    }
    button_state = 0;
    //showYellowFace(matrix);
    break;

  case 6:
    clearMatrix(matrix);
    matrix->drawRGBBitmap(0, 0, sleep1, 24, 8);
    matrix->show();
    delay(1000);
    if (button_state != 6)
      break;
    delay(1000);
    if (button_state != 6)
      break;
    for (int n = 0; n < 100; n++)
    {
      delay(1000);
      if (button_state != 6)
        break;
      sleep_time = n*5;
      matrix->fillRect(12,0,12,8,matrix->Color(0,0,0));
      matrix->setCursor(12, 7);
      matrix->print(sleep_time);
      matrix->show();
      getRTCTime();
      sleep_hour = int(sleep_time / 60);
      sleep_minute = sleep_time % 60;
      sleep_hour = hour + sleep_hour;
      sleep_minute = sleep_minute + minute;
      //Serial.printf("min is:%d,hour is:%d",sleep_minute,sleep_hour);
    }
    showYellowFace(matrix);
    break;

  }
}
